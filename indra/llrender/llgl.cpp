/**
 * @file llgl.cpp
 * @brief LLGL implementation
 *
 * $LicenseInfo:firstyear=2001&license=viewerlgpl$
 * Second Life Viewer Source Code
 * Copyright (C) 2010, Linden Research, Inc.
 *
 * This library is free software; you can redistribute it and/or
 * modify it under the terms of the GNU Lesser General Public
 * License as published by the Free Software Foundation;
 * version 2.1 of the License only.
 *
 * This library is distributed in the hope that it will be useful,
 * but WITHOUT ANY WARRANTY; without even the implied warranty of
 * MERCHANTABILITY or FITNESS FOR A PARTICULAR PURPOSE.  See the GNU
 * Lesser General Public License for more details.
 *
 * You should have received a copy of the GNU Lesser General Public
 * License along with this library; if not, write to the Free Software
 * Foundation, Inc., 51 Franklin Street, Fifth Floor, Boston, MA  02110-1301  USA
 *
 * Linden Research, Inc., 945 Battery Street, San Francisco, CA  94111  USA
 * $/LicenseInfo$
 */

// This file sets some global GL parameters, and implements some
// useful functions for GL operations.

#include "linden_common.h"

#include "boost/tokenizer.hpp"

#include "llsys.h"

#include "llgl.h"
#include "llglstates.h"
#include "llrender.h"

#include "llerror.h"
#include "llerrorcontrol.h"
#include "llquaternion.h"
#include "llmath.h"
#include "m4math.h"
#include "llstring.h"
#include "llstacktrace.h"

#include "llglheaders.h"
#include "llglslshader.h"

#include "glm/glm.hpp"
#include <glm/gtc/matrix_access.hpp>
#include "glm/gtc/type_ptr.hpp"

#if LL_WINDOWS
#include "lldxhardware.h"
#endif

#if LL_SDL
#include "SDL2/SDL_video.h"
#endif

#if LL_WINDOWS
static void* get_gl_proc_address(const char* name)
{
    void* proc = reinterpret_cast<void*>(wglGetProcAddress(name));
    if (!proc || proc == reinterpret_cast<void*>(1) || proc == reinterpret_cast<void*>(2)
        || proc == reinterpret_cast<void*>(3) || proc == reinterpret_cast<void*>(static_cast<size_t>(-1)))
    {
        HMODULE module = GetModuleHandleA("opengl32.dll");
        if (!module) module = LoadLibraryA("opengl32.dll");
        proc = reinterpret_cast<void*>(GetProcAddress(module, name));
    }
    return proc;
}
#elif LL_SDL
static void* get_gl_proc_address(const char* name)
{
    return reinterpret_cast<void*>(SDL_GL_GetProcAddress(name));
}
#else
static void* get_gl_proc_address(const char* name)
{
    return nullptr;
}
#endif

#ifdef _DEBUG
//#define GL_STATE_VERIFY
#endif


bool gDebugSession = false;
bool gDebugGLSession = false;
bool gClothRipple = false;
bool gHeadlessClient = false;
bool gNonInteractive = false;
bool gGLActive = false;

static const std::string HEADLESS_VENDOR_STRING("Linden Lab");
static const std::string HEADLESS_RENDERER_STRING("Headless");
static const std::string HEADLESS_VERSION_STRING("1.0");

llofstream gFailLog;

#if GL_ARB_debug_output

#ifndef APIENTRY
#define APIENTRY
#endif

void APIENTRY gl_debug_callback(GLenum source,
                                GLenum type,
                                GLuint id,
                                GLenum severity,
                                GLsizei length,
                                const GLchar* message,
                                GLvoid* userParam)
{
    /*if (severity != GL_DEBUG_SEVERITY_HIGH &&
        severity != GL_DEBUG_SEVERITY_MEDIUM &&
        severity != GL_DEBUG_SEVERITY_LOW
        )
    { //suppress out-of-spec messages sent by nvidia driver (mostly vertexbuffer hints)
        return;
    }*/

    if (gGLManager.mIsDisabled &&
        severity == GL_DEBUG_SEVERITY_HIGH_ARB &&
        source == GL_DEBUG_SOURCE_API_ARB &&
        type == GL_DEBUG_TYPE_ERROR_ARB &&
        id == GL_INVALID_VALUE)
    {
        // Suppress messages about deleting already deleted objects called from LLViewerWindow::stopGL()
        // "GL_INVALID_VALUE error generated. Handle does not refer to an object generated by OpenGL."
        return;
    }

    // list of messages to suppress
    const char* suppress[] =
    {
        "Buffer detailed info:",
        "Program undefined behavior warning: The current GL state uses a sampler (0) that has depth comparisons enabled"
    };

    for (const char* msg : suppress)
    {
        if (strncmp(msg, message, strlen(msg)) == 0)
        {
            return;
        }
    }

    if (severity == GL_DEBUG_SEVERITY_HIGH)
    {
        LL_WARNS() << "----- GL ERROR --------" << LL_ENDL;
    }
    else
    {
        LL_WARNS() << "----- GL WARNING -------" << LL_ENDL;
    }
    LL_WARNS() << "Type: " << std::hex << type << LL_ENDL;
    LL_WARNS() << "ID: " << std::hex << id << LL_ENDL;
    LL_WARNS() << "Severity: " << std::hex << severity << LL_ENDL;
    LL_WARNS() << "Message: " << message << LL_ENDL;
    LL_WARNS() << "-----------------------" << LL_ENDL;

    GLint vao = 0;
    glGetIntegerv(GL_VERTEX_ARRAY_BINDING, &vao);
    GLint vbo = 0;
    glGetIntegerv(GL_ARRAY_BUFFER_BINDING, &vbo);
    GLint vbo_size = 0;
    if (vbo != 0)
    {
        glGetBufferParameteriv(GL_ARRAY_BUFFER, GL_BUFFER_SIZE, &vbo_size);
    }
    GLint ibo = 0;
    glGetIntegerv(GL_ELEMENT_ARRAY_BUFFER_BINDING, &ibo);
    GLint ibo_size = 0;
    if (ibo != 0)
    {
        glGetBufferParameteriv(GL_ELEMENT_ARRAY_BUFFER, GL_BUFFER_SIZE, &ibo_size);
    }
    GLint ubo = 0;
    glGetIntegerv(GL_UNIFORM_BUFFER_BINDING, &ubo);
    GLint ubo_size = 0;
    GLint ubo_immutable = 0;
    if (ubo != 0)
    {
        glGetBufferParameteriv(GL_UNIFORM_BUFFER, GL_BUFFER_SIZE, &ubo_size);
        glGetBufferParameteriv(GL_UNIFORM_BUFFER, GL_BUFFER_IMMUTABLE_STORAGE, &ubo_immutable);
    }

    // No needs to halt when is called from LLViewerWindow::stopGL()
    if (severity == GL_DEBUG_SEVERITY_HIGH && !gGLManager.mIsDisabled)
    {
        LL_ERRS() << "Halting on GL Error" << LL_ENDL;
    }
}
#endif

void parse_glsl_version(S32& major, S32& minor);

void ll_init_fail_log(std::string filename)
{
    gFailLog.open(filename.c_str());
}


void ll_fail(std::string msg)
{

    if (gDebugSession)
    {
        std::vector<std::string> lines;

        gFailLog << LLError::utcTime() << " " << msg << std::endl;

        gFailLog << "Stack Trace:" << std::endl;

        ll_get_stack_trace(lines);

        for(size_t i = 0; i < lines.size(); ++i)
        {
            gFailLog << lines[i] << std::endl;
        }

        gFailLog << "End of Stack Trace." << std::endl << std::endl;

        gFailLog.flush();
    }
};

void ll_close_fail_log()
{
    gFailLog.close();
}

LLMatrix4 gGLObliqueProjectionInverse;

#define LL_GL_NAME_POOLING 0

std::list<LLGLUpdate*> LLGLUpdate::sGLQ;



LLGLManager gGLManager;

LLGLManager::LLGLManager() :
    mInited(false),
    mIsDisabled(false),
    mMaxSamples(0),
    mNumTextureImageUnits(1),
    mMaxSampleMaskWords(0),
    mMaxColorTextureSamples(0),
    mMaxDepthTextureSamples(0),
    mMaxIntegerSamples(0),
    mIsAMD(false),
    mIsNVIDIA(false),
    mIsIntel(false),
#if LL_DARWIN
    mIsMobileGF(false),
#endif
    mHasRequirements(true),
    mDriverVersionMajor(1),
    mDriverVersionMinor(0),
    mDriverVersionRelease(0),
    mGLVersion(1.0f),
    mGLSLVersionMajor(0),
    mGLSLVersionMinor(0),
    mVRAM(0),
    mVRAMDetected(0), // <FS:Beq/> add override support
    mGLMaxVertexRange(0),
    mGLMaxIndexRange(0)
{
}

//---------------------------------------------------------------------
// Global initialization for GL
//---------------------------------------------------------------------
#if LL_WINDOWS
// WGL_ARB_create_context
PFNWGLCREATECONTEXTATTRIBSARBPROC wglCreateContextAttribsARB = nullptr;

// WGL_ARB_pixel_format
PFNWGLCHOOSEPIXELFORMATARBPROC wglChoosePixelFormatARB = nullptr;
PFNWGLGETPIXELFORMATATTRIBIVARBPROC wglGetPixelFormatAttribivARB = nullptr;

// WGL_AMD_gpu_association
PFNWGLGETGPUIDSAMDPROC                          wglGetGPUIDsAMD = nullptr;
PFNWGLGETGPUINFOAMDPROC                         wglGetGPUInfoAMD = nullptr;
PFNWGLGETCONTEXTGPUIDAMDPROC                    wglGetContextGPUIDAMD = nullptr;
PFNWGLCREATEASSOCIATEDCONTEXTAMDPROC            wglCreateAssociatedContextAMD = nullptr;
PFNWGLCREATEASSOCIATEDCONTEXTATTRIBSAMDPROC     wglCreateAssociatedContextAttribsAMD = nullptr;
PFNWGLDELETEASSOCIATEDCONTEXTAMDPROC            wglDeleteAssociatedContextAMD = nullptr;
PFNWGLMAKEASSOCIATEDCONTEXTCURRENTAMDPROC       wglMakeAssociatedContextCurrentAMD = nullptr;
PFNWGLGETCURRENTASSOCIATEDCONTEXTAMDPROC        wglGetCurrentAssociatedContextAMD = nullptr;
PFNWGLBLITCONTEXTFRAMEBUFFERAMDPROC             wglBlitContextFramebufferAMD = nullptr;

// WGL_EXT_swap_control
PFNWGLSWAPINTERVALEXTPROC    wglSwapIntervalEXT = nullptr;
PFNWGLGETSWAPINTERVALEXTPROC wglGetSwapIntervalEXT = nullptr;
#endif

#if LL_WINDOWS && !LL_MESA_HEADLESS
void LLGLManager::initWGL()
{
    // Load WGL extension function pointers needed before context creation
    wglCreateContextAttribsARB = (PFNWGLCREATECONTEXTATTRIBSARBPROC)get_gl_proc_address("wglCreateContextAttribsARB");
    wglChoosePixelFormatARB = (PFNWGLCHOOSEPIXELFORMATARBPROC)get_gl_proc_address("wglChoosePixelFormatARB");
    wglGetPixelFormatAttribivARB = (PFNWGLGETPIXELFORMATATTRIBIVARBPROC)get_gl_proc_address("wglGetPixelFormatAttribivARB");

    if (wglCreateContextAttribsARB)
    {
        mHasRequirements = true;
    }
    else
    {
        LL_WARNS("RenderInit") << "No WGL_ARB_create_context" << LL_ENDL;
    }

    // WGL swap control
    wglSwapIntervalEXT = (PFNWGLSWAPINTERVALEXTPROC)get_gl_proc_address("wglSwapIntervalEXT");
    wglGetSwapIntervalEXT = (PFNWGLGETSWAPINTERVALEXTPROC)get_gl_proc_address("wglGetSwapIntervalEXT");
}
#endif

// return false if unable (or unwilling due to old drivers) to init GL
bool LLGLManager::initGL()
{
    LL_INFOS("RenderInit") << "Initializing OpenGL" << LL_ENDL; // <FS:Beq/> Extra logging to confirm usage on Linux
    if (mInited)
    {
        LL_ERRS("RenderInit") << "Calling init on LLGLManager after already initialized!" << LL_ENDL;
    }

    // Extract video card strings and convert to upper case to
    // work around driver-to-driver variation in capitalization.
    mGLVendor = ll_safe_string((const char *)glGetString(GL_VENDOR));
    LLStringUtil::toUpper(mGLVendor);

    mGLRenderer = ll_safe_string((const char *)glGetString(GL_RENDERER));
    LLStringUtil::toUpper(mGLRenderer);

    parse_gl_version( &mDriverVersionMajor,
        &mDriverVersionMinor,
        &mDriverVersionRelease,
        &mDriverVersionVendorString,
        &mGLVersionString);

    mGLVersion = mDriverVersionMajor + mDriverVersionMinor * .1f;

    if (mGLVersion >= 2.f)
    {
        parse_glsl_version(mGLSLVersionMajor, mGLSLVersionMinor);
    }

    if (mGLVersion >= 2.1f && LLImageGL::sCompressTextures)
    { //use texture compression
        glHint(GL_TEXTURE_COMPRESSION_HINT, GL_NICEST);
    }
    else
    { //GL version is < 3.0, always disable texture compression
        LLImageGL::sCompressTextures = false;
    }

    // Trailing space necessary to keep "nVidia Corpor_ati_on" cards
    // from being recognized as ATI.
    // NOTE: AMD has been pretty good about not breaking this check, do not rename without good reason
    if (mGLVendor.substr(0,4) == "ATI " || mGLVendor.find("AMD") != std::string::npos)
    {
        mGLVendorShort = "AMD";
        // *TODO: Fix this?
        mIsAMD = true;
    }
    else if (mGLVendor.find("NVIDIA ") != std::string::npos)
    {
        mGLVendorShort = "NVIDIA";
        mIsNVIDIA = true;
    }
    else if (mGLVendor.find("INTEL") != std::string::npos
#if LL_LINUX
         // The Mesa-based drivers put this in the Renderer string,
         // not the Vendor string.
         || mGLRenderer.find("INTEL") != std::string::npos
#endif //LL_LINUX
         )
    {
        mGLVendorShort = "INTEL";
        mIsIntel = true;
    }
    else if (mGLVendor.find("APPLE") != std::string::npos)
    {
        mGLVendorShort = "APPLE";
        mIsApple = true;
    }
    else
    {
        mGLVendorShort = "MISC";
    }

    // This is called here because it depends on the setting of mIsGF2or4MX, and sets up mHasMultitexture.
    initExtensions();

    // <FS:Beq> stop doing this and trust the hardware detection
    // if hardware detection has all failed the this will correct for that
    // U32 old_vram = mVRAM;
    // mVRAM = 0;

#if 0 //LL_WINDOWS <FS:Ansariel> Special handling down below
    if (mHasAMDAssociations)
    {
        GLuint gl_gpus_count = wglGetGPUIDsAMD(0, 0);
        if (gl_gpus_count > 0)
        {
            GLuint* ids = new GLuint[gl_gpus_count];
            wglGetGPUIDsAMD(gl_gpus_count, ids);

            GLuint mem_mb = 0;
            for (U32 i = 0; i < gl_gpus_count; i++)
            {
                wglGetGPUInfoAMD(ids[i],
                    WGL_GPU_RAM_AMD,
                    GL_UNSIGNED_INT,
                    sizeof(GLuint),
                    &mem_mb);
                if (mVRAM < mem_mb)
                {
                    // basically pick the best AMD and trust driver/OS to know to switch
                    mVRAM = mem_mb;
                }
            }
        }
        if (mVRAM != 0)
        {
            LL_WARNS("RenderInit") << "VRAM Detected (AMDAssociations):" << mVRAM << LL_ENDL;
        }
    }
    else if (mHasNVXGpuMemoryInfo)
    {
        GLint mem_kb = 0;
        glGetIntegerv(GL_GPU_MEMORY_INFO_DEDICATED_VIDMEM_NVX, &mem_kb);
        mVRAM = mem_kb / 1024;

        if (mVRAM != 0)
        {
            LL_WARNS("RenderInit") << "VRAM Detected (NVXGpuMemoryInfo):" << mVRAM << LL_ENDL;
        }
    }
#endif

// <FS:Beq> remove this so that we can attempt to use driver specifics
// if it fails we will pick up the `old_vram` value , which is either WMI or the combined dxdiag number
// both of which are rather useless, but it does at least respect the disable_wmi setting.

    // Ultimate fallbacks for linux and mesa
    if (mHasNVXGpuMemoryInfo && mVRAM == 0)
    {
        S32 dedicated_memory;
        glGetIntegerv(GL_GPU_MEMORY_INFO_DEDICATED_VIDMEM_NVX, &dedicated_memory);
        mVRAM = dedicated_memory/1024;
        LL_INFOS("RenderInit") << "VRAM Detected (NVXMemInfo):" << mVRAM << LL_ENDL;
    }

#ifdef LL_WINDOWS
    if (mHasAMDAssociations && mVRAM == 0)
    {
        GLuint gl_gpus_count = wglGetGPUIDsAMD(0, 0);
        if (gl_gpus_count > 0)
        {
            GLuint* ids = new GLuint[gl_gpus_count];
            wglGetGPUIDsAMD(gl_gpus_count, ids);

            GLuint mem_mb = 0;
            for (U32 i = 0; i < gl_gpus_count; i++)
            {
                wglGetGPUInfoAMD(ids[i],
                    WGL_GPU_RAM_AMD,
                    GL_UNSIGNED_INT,
                    sizeof(GLuint),
                    &mem_mb);
                if (mVRAM < mem_mb)
                {
                    // basically pick the best AMD and trust driver/OS to know to switch
                    mVRAM = mem_mb;
                }
            }
        }
        LL_INFOS("RenderInit") << "VRAM Detected (AMDAssociations):" << mVRAM << LL_ENDL;
    }
#endif

    if (mHasATIMemInfo && mVRAM == 0)
    { //ask the gl how much vram is free at startup and attempt to use no more than half of that
        S32 meminfo[4];
        glGetIntegerv(GL_TEXTURE_FREE_MEMORY_ATI, meminfo);

        mVRAM = meminfo[0] / 1024;
        LL_INFOS("RenderInit") << "VRAM Detected (ATIMemInfo):" << mVRAM << LL_ENDL;
    }
    // <FS:Beq> stop doing this and trust the hardware detection
    // if (mVRAM < 256 && old_vram > 0)
    // {
    //  // fall back to old method
    //  mVRAM = old_vram;

    // }
    // </FS:Beq>
    glGetIntegerv(GL_MAX_TEXTURE_IMAGE_UNITS, &mNumTextureImageUnits);
    glGetIntegerv(GL_MAX_COLOR_TEXTURE_SAMPLES, &mMaxColorTextureSamples);
    glGetIntegerv(GL_MAX_DEPTH_TEXTURE_SAMPLES, &mMaxDepthTextureSamples);
    glGetIntegerv(GL_MAX_INTEGER_SAMPLES, &mMaxIntegerSamples);
    glGetIntegerv(GL_MAX_SAMPLE_MASK_WORDS, &mMaxSampleMaskWords);
    glGetIntegerv(GL_MAX_SAMPLES, &mMaxSamples);
    glGetIntegerv(GL_MAX_VARYING_VECTORS, &mMaxVaryingVectors);
    glGetIntegerv(GL_MAX_UNIFORM_BLOCK_SIZE, &mMaxUniformBlockSize);

    // sanity clamp max uniform block size to 64k just in case
    // there's some implementation that reports a crazy value
    mMaxUniformBlockSize = llmin(mMaxUniformBlockSize, 65536);

    if (mHasAnisotropic)
    {
        glGetFloatv(GL_MAX_TEXTURE_MAX_ANISOTROPY, &mMaxAnisotropy);
    }

    initGLStates();

    return true;
}

void LLGLManager::getGLInfo(LLSD& info)
{
    if (gHeadlessClient)
    {
        info["GLInfo"]["GLVendor"] = HEADLESS_VENDOR_STRING;
        info["GLInfo"]["GLRenderer"] = HEADLESS_RENDERER_STRING;
        info["GLInfo"]["GLVersion"] = HEADLESS_VERSION_STRING;
        return;
    }
    else
    {
        info["GLInfo"]["GLVendor"] = ll_safe_string((const char *)glGetString(GL_VENDOR));
        info["GLInfo"]["GLRenderer"] = ll_safe_string((const char *)glGetString(GL_RENDERER));
        info["GLInfo"]["GLVersion"] = ll_safe_string((const char *)glGetString(GL_VERSION));
    }

#if !LL_MESA_HEADLESS
    std::string all_exts;
    {
        GLint num_extensions = 0;
        glGetIntegerv(GL_NUM_EXTENSIONS, &num_extensions);
        for (GLint i = 0; i < num_extensions; ++i)
        {
            all_exts += ll_safe_string((const char*)glGetStringi(GL_EXTENSIONS, i));
            all_exts += " ";
        }
    }
    boost::char_separator<char> sep(" ");
    boost::tokenizer<boost::char_separator<char> > tok(all_exts, sep);
    for(boost::tokenizer<boost::char_separator<char> >::iterator i = tok.begin(); i != tok.end(); ++i)
    {
        info["GLInfo"]["GLExtensions"].append(*i);
    }
#endif
}

std::string LLGLManager::getGLInfoString()
{
    std::string info_str;

    if (gHeadlessClient)
    {
        info_str += std::string("GL_VENDOR      ") + HEADLESS_VENDOR_STRING + std::string("\n");
        info_str += std::string("GL_RENDERER    ") + HEADLESS_RENDERER_STRING + std::string("\n");
        info_str += std::string("GL_VERSION     ") + HEADLESS_VERSION_STRING + std::string("\n");
    }
    else
    {
        info_str += std::string("GL_VENDOR      ") + ll_safe_string((const char *)glGetString(GL_VENDOR)) + std::string("\n");
        info_str += std::string("GL_RENDERER    ") + ll_safe_string((const char *)glGetString(GL_RENDERER)) + std::string("\n");
        info_str += std::string("GL_VERSION     ") + ll_safe_string((const char *)glGetString(GL_VERSION)) + std::string("\n");
    }

#if !LL_MESA_HEADLESS
    std::string all_exts;
    {
        GLint num_extensions = 0;
        glGetIntegerv(GL_NUM_EXTENSIONS, &num_extensions);
        for (GLint i = 0; i < num_extensions; ++i)
        {
            all_exts += ll_safe_string((const char*)glGetStringi(GL_EXTENSIONS, i));
            all_exts += ' ';
        }
    }
    LLStringUtil::replaceChar(all_exts, ' ', '\n');
    info_str += std::string("GL_EXTENSIONS:\n") + all_exts + std::string("\n");
#endif

    return info_str;
}

void LLGLManager::printGLInfoString()
{
    if (gHeadlessClient)
    {
        LL_INFOS("RenderInit") << "GL_VENDOR:     " << HEADLESS_VENDOR_STRING << LL_ENDL;
        LL_INFOS("RenderInit") << "GL_RENDERER:   " << HEADLESS_RENDERER_STRING << LL_ENDL;
        LL_INFOS("RenderInit") << "GL_VERSION:    " << HEADLESS_VERSION_STRING << LL_ENDL;
    }
    else
    {
        LL_INFOS("RenderInit") << "GL_VENDOR:     " << ll_safe_string((const char *)glGetString(GL_VENDOR)) << LL_ENDL;
        LL_INFOS("RenderInit") << "GL_RENDERER:   " << ll_safe_string((const char *)glGetString(GL_RENDERER)) << LL_ENDL;
        LL_INFOS("RenderInit") << "GL_VERSION:    " << ll_safe_string((const char *)glGetString(GL_VERSION)) << LL_ENDL;
    }

#if !LL_MESA_HEADLESS
    std::string all_exts;
    {
        GLint num_extensions = 0;
        glGetIntegerv(GL_NUM_EXTENSIONS, &num_extensions);
        for (GLint i = 0; i < num_extensions; ++i)
        {
            all_exts += ll_safe_string((const char*)glGetStringi(GL_EXTENSIONS, i));
            all_exts += ' ';
        }
    }
    LLStringUtil::replaceChar(all_exts, ' ', '\n');
    LL_DEBUGS("RenderInit") << "GL_EXTENSIONS:\n" << all_exts << LL_ENDL;
#endif
}

std::string LLGLManager::getRawGLString()
{
    std::string gl_string;
    if (gHeadlessClient)
    {
        gl_string = HEADLESS_VENDOR_STRING + " " + HEADLESS_RENDERER_STRING;
    }
    else
    {
        gl_string = ll_safe_string((char*)glGetString(GL_VENDOR)) + " " + ll_safe_string((char*)glGetString(GL_RENDERER));
    }
    return gl_string;
}

void LLGLManager::asLLSD(LLSD& info)
{
    // Currently these are duplicates of fields in "system".
    info["gpu_vendor"] = mGLVendorShort;
    info["gpu_version"] = mDriverVersionVendorString;
    info["opengl_version"] = mGLVersionString;

    info["vram"] = LLSD::Integer(mVRAM);

    // OpenGL limits
    info["max_samples"] = mMaxSamples;
    info["num_texture_image_units"] =  mNumTextureImageUnits;
    info["max_sample_mask_words"] = mMaxSampleMaskWords;
    info["max_color_texture_samples"] = mMaxColorTextureSamples;
    info["max_depth_texture_samples"] = mMaxDepthTextureSamples;
    info["max_integer_samples"] = mMaxIntegerSamples;
    info["max_vertex_range"] = mGLMaxVertexRange;
    info["max_index_range"] = mGLMaxIndexRange;
    info["max_texture_size"] = mGLMaxTextureSize;

    // Which vendor
    info["is_ati"] = mIsAMD;  // note, do not rename is_ati to is_amd without coordinating with DW
    info["is_nvidia"] = mIsNVIDIA;
    info["is_intel"] = mIsIntel;

    info["gl_renderer"] = mGLRenderer;
}

void LLGLManager::shutdownGL()
{
    if (mInited)
    {
        glFinish();
        stop_glerror();
        mInited = false;
    }
}

// these are used to turn software blending on. They appear in the Debug/Avatar menu
// presence of vertex skinning/blending or vertex programs will set these to false by default.

void LLGLManager::initExtensions()
{
    // Load OpenGL function pointers via glad
    if (!gladLoadGLLoader((GLADloadproc)get_gl_proc_address))
    {
        LL_WARNS("RenderInit") << "Failed to load OpenGL via glad" << LL_ENDL;
        mHasRequirements = false;
        return;
    }

    // OpenGL version from glad
    mGLVersion = GLVersion.major + GLVersion.minor * 0.1f;

    // OpenGL 4.x capabilities
    mHasCubeMapArray = GLVersion.major >= 4;
    mHasTransformFeedback = GLVersion.major >= 4;
    mHasDebugOutput = GLVersion.major >= 4 && GLVersion.minor >= 3;
    mHasAnisotropic = GLAD_GL_EXT_texture_filter_anisotropic != 0;

    // Misc
    glGetIntegerv(GL_MAX_ELEMENTS_VERTICES, (GLint*) &mGLMaxVertexRange);
    glGetIntegerv(GL_MAX_ELEMENTS_INDICES, (GLint*) &mGLMaxIndexRange);
    glGetIntegerv(GL_MAX_TEXTURE_SIZE, (GLint*) &mGLMaxTextureSize);

    mInited = true;

    // Vendor-specific memory info extensions
    mHasATIMemInfo = GLAD_GL_ATI_meminfo != 0;
    mHasNVXGpuMemoryInfo = GLAD_GL_NVX_gpu_memory_info != 0;

#if LL_WINDOWS
    // Load WGL AMD extension function pointers
    wglGetGPUIDsAMD = (PFNWGLGETGPUIDSAMDPROC)get_gl_proc_address("wglGetGPUIDsAMD");
    wglGetGPUInfoAMD = (PFNWGLGETGPUINFOAMDPROC)get_gl_proc_address("wglGetGPUInfoAMD");
    wglGetContextGPUIDAMD = (PFNWGLGETCONTEXTGPUIDAMDPROC)get_gl_proc_address("wglGetContextGPUIDAMD");
    wglCreateAssociatedContextAMD = (PFNWGLCREATEASSOCIATEDCONTEXTAMDPROC)get_gl_proc_address("wglCreateAssociatedContextAMD");
    wglCreateAssociatedContextAttribsAMD = (PFNWGLCREATEASSOCIATEDCONTEXTATTRIBSAMDPROC)get_gl_proc_address("wglCreateAssociatedContextAttribsAMD");
    wglDeleteAssociatedContextAMD = (PFNWGLDELETEASSOCIATEDCONTEXTAMDPROC)get_gl_proc_address("wglDeleteAssociatedContextAMD");
    wglMakeAssociatedContextCurrentAMD = (PFNWGLMAKEASSOCIATEDCONTEXTCURRENTAMDPROC)get_gl_proc_address("wglMakeAssociatedContextCurrentAMD");
    wglGetCurrentAssociatedContextAMD = (PFNWGLGETCURRENTASSOCIATEDCONTEXTAMDPROC)get_gl_proc_address("wglGetCurrentAssociatedContextAMD");
    wglBlitContextFramebufferAMD = (PFNWGLBLITCONTEXTFRAMEBUFFERAMDPROC)get_gl_proc_address("wglBlitContextFramebufferAMD");

    // WGL swap control
    wglSwapIntervalEXT = (PFNWGLSWAPINTERVALEXTPROC)get_gl_proc_address("wglSwapIntervalEXT");
    wglGetSwapIntervalEXT = (PFNWGLGETSWAPINTERVALEXTPROC)get_gl_proc_address("wglGetSwapIntervalEXT");

    // WGL create context attribs
    wglCreateContextAttribsARB = (PFNWGLCREATECONTEXTATTRIBSARBPROC)get_gl_proc_address("wglCreateContextAttribsARB");
#endif
}

void rotate_quat(LLQuaternion& rotation)
{
    F32 angle_radians, x, y, z;
    rotation.getAngleAxis(&angle_radians, &x, &y, &z);
    gGL.rotatef(angle_radians * RAD_TO_DEG, x, y, z);
}

void flush_glerror()
{
    glGetError();
}

//this function outputs gl error to the log file, does not crash the code.
void log_glerror()
{
    if (LL_UNLIKELY(!gGLManager.mInited))
    {
        return ;
    }
    //  Create or update texture to be used with this data
    GLenum error;
    error = glGetError();
    while (LL_UNLIKELY(error))
    {
        GLubyte const * gl_error_msg = gluErrorString(error);
        if (NULL != gl_error_msg)
        {
            LL_WARNS() << "GL Error: " << error << " GL Error String: " << gl_error_msg << LL_ENDL ;
        }
        else
        {
            // gluErrorString returns NULL for some extensions' error codes.
            // you'll probably have to grep for the number in glext.h.
            LL_WARNS() << "GL Error: UNKNOWN 0x" << std::hex << error << std::dec << LL_ENDL;
        }
        error = glGetError();
    }
}

void do_assert_glerror()
{
    //  Create or update texture to be used with this data
    GLenum error;
    error = glGetError();
    bool quit = false;
    if (LL_UNLIKELY(error))
    {
        quit = true;
        GLubyte const * gl_error_msg = gluErrorString(error);
        if (NULL != gl_error_msg)
        {
            LL_WARNS("RenderState") << "GL Error:" << error<< LL_ENDL;
            LL_WARNS("RenderState") << "GL Error String:" << gl_error_msg << LL_ENDL;

            if (gDebugSession)
            {
                gFailLog << "GL Error:" << gl_error_msg << std::endl;
            }
        }
        else
        {
            // gluErrorString returns NULL for some extensions' error codes.
            // you'll probably have to grep for the number in glext.h.
            LL_WARNS("RenderState") << "GL Error: UNKNOWN 0x" << std::hex << error << std::dec << LL_ENDL;

            if (gDebugSession)
            {
                gFailLog << "GL Error: UNKNOWN 0x" << std::hex << error << std::dec << std::endl;
            }
        }
    }

    if (quit)
    {
        if (gDebugSession)
        {
            ll_fail("assert_glerror failed");
        }
        else
        {
            LL_ERRS() << "One or more unhandled GL errors." << LL_ENDL;
        }
    }
}

void assert_glerror()
{
/*  if (!gGLActive)
    {
        //LL_WARNS() << "GL used while not active!" << LL_ENDL;

        if (gDebugSession)
        {
            //ll_fail("GL used while not active");
        }
    }
*/

    if (!gDebugGL)
    {
        //funny looking if for branch prediction -- gDebugGL is almost always false and assert_glerror is called often
    }
    else
    {
        do_assert_glerror();
    }
}


void clear_glerror()
{
    glGetError();
    glGetError();
}

///////////////////////////////////////////////////////////////
//
// LLGLState
//

// Static members
boost::unordered_map<LLGLenum, LLGLboolean> LLGLState::sStateMap;

GLboolean LLGLDepthTest::sDepthEnabled = GL_FALSE; // OpenGL default
GLenum LLGLDepthTest::sDepthFunc = GL_LESS; // OpenGL default
GLboolean LLGLDepthTest::sWriteEnabled = GL_TRUE; // OpenGL default

//static
void LLGLState::initClass()
{
    sStateMap[GL_DITHER] = GL_TRUE;
    // sStateMap[GL_TEXTURE_2D] = GL_TRUE;

    //make sure multisample defaults to disabled
    sStateMap[GL_MULTISAMPLE] = GL_FALSE;
    glDisable(GL_MULTISAMPLE);
}

//static
void LLGLState::restoreGL()
{
    sStateMap.clear();
    initClass();
}

//static
// Really shouldn't be needed, but seems we sometimes do.
void LLGLState::resetTextureStates()
{
    gGL.flush();
    GLint maxTextureUnits;

    glGetIntegerv(GL_MAX_TEXTURE_UNITS_ARB, &maxTextureUnits);
    for (S32 j = maxTextureUnits-1; j >=0; j--)
    {
        gGL.getTexUnit(j)->activate();
        glClientActiveTexture(GL_TEXTURE0+j);
        j == 0 ? gGL.getTexUnit(j)->enable(LLTexUnit::TT_TEXTURE) : gGL.getTexUnit(j)->disable();
    }
}

void LLGLState::dumpStates()
{
    LL_INFOS("RenderState") << "GL States:" << LL_ENDL;
    for (boost::unordered_map<LLGLenum, LLGLboolean>::iterator iter = sStateMap.begin();
         iter != sStateMap.end(); ++iter)
    {
        LL_INFOS("RenderState") << llformat(" 0x%04x : %s",(S32)iter->first,iter->second?"true":"false") << LL_ENDL;
    }
}

void LLGLState::checkStates(GLboolean writeAlpha)
{
    if (!gDebugGL)
    {
        return;
    }

    GLint srcRGB, dstRGB, srcAlpha, dstAlpha;
    glGetIntegerv(GL_BLEND_SRC_RGB, &srcRGB);
    glGetIntegerv(GL_BLEND_DST_RGB, &dstRGB);
    glGetIntegerv(GL_BLEND_SRC_ALPHA, &srcAlpha);
    glGetIntegerv(GL_BLEND_DST_ALPHA, &dstAlpha);
    llassert_always(srcRGB == GL_SRC_ALPHA);
    llassert_always(srcAlpha == GL_SRC_ALPHA);
    llassert_always(dstRGB == GL_ONE_MINUS_SRC_ALPHA);
    llassert_always(dstAlpha == GL_ONE_MINUS_SRC_ALPHA);

    // disable for now until usage is consistent
    //GLboolean colorMask[4];
    //glGetBooleanv(GL_COLOR_WRITEMASK, colorMask);
    //llassert_always(colorMask[0]);
    //llassert_always(colorMask[1]);
    //llassert_always(colorMask[2]);
    // llassert_always(colorMask[3] == writeAlpha);

    for (boost::unordered_map<LLGLenum, LLGLboolean>::iterator iter = sStateMap.begin();
         iter != sStateMap.end(); ++iter)
    {
        LLGLenum state = iter->first;
        LLGLboolean cur_state = iter->second;
        LLGLboolean gl_state = glIsEnabled(state);
        if(cur_state != gl_state)
        {
            dumpStates();
            LL_GL_ERRS << llformat("LLGLState error. State: 0x%04x",state) << LL_ENDL;
        }
    }
}

///////////////////////////////////////////////////////////////////////

LLGLState::LLGLState(LLGLenum state, S32 enabled) :
    mState(state), mWasEnabled(false), mIsEnabled(false)
{
    LL_PROFILE_ZONE_SCOPED_CATEGORY_PIPELINE;

    if (mState)
    {
        mWasEnabled = sStateMap[state];
        setEnabled(enabled);
    }
}

void LLGLState::setEnabled(S32 enabled)
{
    if (!mState)
    {
        return;
    }
    if (enabled == CURRENT_STATE)
    {
        enabled = sStateMap[mState] == GL_TRUE ? ENABLED_STATE : DISABLED_STATE;
    }
    else if (enabled == ENABLED_STATE && sStateMap[mState] != GL_TRUE)
    {
        gGL.flush();
        glEnable(mState);
        sStateMap[mState] = GL_TRUE;
    }
    else if (enabled == DISABLED_STATE && sStateMap[mState] != GL_FALSE)
    {
        gGL.flush();
        glDisable(mState);
        sStateMap[mState] = GL_FALSE;
    }
    mIsEnabled = enabled;
}

LLGLState::~LLGLState()
{
    LL_PROFILE_ZONE_SCOPED_CATEGORY_PIPELINE;
    if (mState)
    {
        if (gDebugGL)
        {
            if (!gDebugSession)
            {
                llassert_always(sStateMap[mState] == glIsEnabled(mState));
            }
            else
            {
                if (sStateMap[mState] != glIsEnabled(mState))
                {
                    ll_fail("GL enabled state does not match expected");
                }
            }
        }

        if (mIsEnabled != mWasEnabled)
        {
            gGL.flush();
            if (mWasEnabled)
            {
                glEnable(mState);
                sStateMap[mState] = GL_TRUE;
            }
            else
            {
                glDisable(mState);
                sStateMap[mState] = GL_FALSE;
            }
        }
    }
}

////////////////////////////////////////////////////////////////////////////////

void LLGLManager::initGLStates()
{
    //gl states moved to classes in llglstates.h
    LLGLState::initClass();
}

////////////////////////////////////////////////////////////////////////////////

void parse_gl_version( S32* major, S32* minor, S32* release, std::string* vendor_specific, std::string* version_string )
{
    // GL_VERSION returns a null-terminated string with the format:
    // <major>.<minor>[.<release>] [<vendor specific>]

    const char* version = (const char*) glGetString(GL_VERSION);
    *major = 0;
    *minor = 0;
    *release = 0;
    vendor_specific->assign("");

    if( !version )
    {
        return;
    }

    version_string->assign(version);

    std::string ver_copy( version );
    S32 len = (S32)strlen( version );   /* Flawfinder: ignore */
    S32 i = 0;
    S32 start;
    // Find the major version
    start = i;
    for( ; i < len; i++ )
    {
        if( '.' == version[i] )
        {
            break;
        }
    }
    std::string major_str = ver_copy.substr(start,i-start);
    LLStringUtil::convertToS32(major_str, *major);

    if( '.' == version[i] )
    {
        i++;
    }

    // Find the minor version
    start = i;
    for( ; i < len; i++ )
    {
        if( ('.' == version[i]) || isspace(version[i]) )
        {
            break;
        }
    }
    std::string minor_str = ver_copy.substr(start,i-start);
    LLStringUtil::convertToS32(minor_str, *minor);

    // Find the release number (optional)
    if( '.' == version[i] )
    {
        i++;

        start = i;
        for( ; i < len; i++ )
        {
            if( isspace(version[i]) )
            {
                break;
            }
        }

        std::string release_str = ver_copy.substr(start,i-start);
        LLStringUtil::convertToS32(release_str, *release);
    }

    // Skip over any white space
    while( version[i] && isspace( version[i] ) )
    {
        i++;
    }

    // Copy the vendor-specific string (optional)
    if( version[i] )
    {
        vendor_specific->assign( version + i );
    }
}


void parse_glsl_version(S32& major, S32& minor)
{
    // GL_SHADING_LANGUAGE_VERSION returns a null-terminated string with the format:
    // <major>.<minor>[.<release>] [<vendor specific>]

    const char* version = (const char*) glGetString(GL_SHADING_LANGUAGE_VERSION);
    major = 0;
    minor = 0;

    if( !version )
    {
        return;
    }

    std::string ver_copy( version );
    S32 len = (S32)strlen( version );   /* Flawfinder: ignore */
    S32 i = 0;
    S32 start;
    // Find the major version
    start = i;
    for( ; i < len; i++ )
    {
        if( '.' == version[i] )
        {
            break;
        }
    }
    std::string major_str = ver_copy.substr(start,i-start);
    LLStringUtil::convertToS32(major_str, major);

    if( '.' == version[i] )
    {
        i++;
    }

    // Find the minor version
    start = i;
    for( ; i < len; i++ )
    {
        if( ('.' == version[i]) || isspace(version[i]) )
        {
            break;
        }
    }
    std::string minor_str = ver_copy.substr(start,i-start);
    LLStringUtil::convertToS32(minor_str, minor);
}

LLGLUserClipPlane::LLGLUserClipPlane(const LLPlane& p, const glm::mat4& modelview, const glm::mat4& projection, bool apply)
{
    mApply = apply;

    if (mApply)
    {
        mModelview = modelview;
        mProjection = projection;

        //flip incoming LLPlane to get consistent behavior compared to frustum culling
        setPlane(-p[0], -p[1], -p[2], -p[3]);
    }
}

void LLGLUserClipPlane::disable()
{
    if (mApply)
    {
        gGL.matrixMode(LLRender::MM_PROJECTION);
        gGL.popMatrix();
        gGL.matrixMode(LLRender::MM_MODELVIEW);
    }
    mApply = false;
}

void LLGLUserClipPlane::setPlane(F32 a, F32 b, F32 c, F32 d)
{
    const glm::mat4& P = mProjection;
    const glm::mat4& M = mModelview;

    glm::mat4 invtrans_MVP = glm::transpose(glm::inverse(P*M));
    glm::vec4 oplane(a,b,c,d);
    glm::vec4 cplane = invtrans_MVP * oplane;

    cplane /= fabs(cplane[2]); // normalize such that depth is not scaled
    cplane[3] -= 1;

    if(cplane[2] < 0)
        cplane *= -1;

    glm::mat4 suffix = glm::identity<glm::mat4>();
    suffix = glm::row(suffix, 2, cplane);
    glm::mat4 newP = suffix * P;
    gGL.matrixMode(LLRender::MM_PROJECTION);
    gGL.pushMatrix();
    gGL.loadMatrix(glm::value_ptr(newP));
    gGLObliqueProjectionInverse = LLMatrix4(glm::value_ptr(glm::transpose(glm::inverse(newP))));
    gGL.matrixMode(LLRender::MM_MODELVIEW);
}

LLGLUserClipPlane::~LLGLUserClipPlane()
{
    disable();
}

LLGLDepthTest::LLGLDepthTest(GLboolean depth_enabled, GLboolean write_enabled, GLenum depth_func)
: mPrevDepthEnabled(sDepthEnabled), mPrevDepthFunc(sDepthFunc), mPrevWriteEnabled(sWriteEnabled)
{
    stop_glerror();
    LL_PROFILE_ZONE_SCOPED_CATEGORY_PIPELINE;
    checkState();

    if (!depth_enabled)
    { // always disable depth writes if depth testing is disabled
      // GL spec defines this as a requirement, but some implementations allow depth writes with testing disabled
      // The proper way to write to depth buffer with testing disabled is to enable testing and use a depth_func of GL_ALWAYS
        write_enabled = GL_FALSE;
    }

    if (depth_enabled != sDepthEnabled)
    {
        gGL.flush();
        if (depth_enabled) glEnable(GL_DEPTH_TEST);
        else glDisable(GL_DEPTH_TEST);
        sDepthEnabled = depth_enabled;
    }
    if (depth_func != sDepthFunc)
    {
        gGL.flush();
        glDepthFunc(depth_func);
        sDepthFunc = depth_func;
    }
    if (write_enabled != sWriteEnabled)
    {
        gGL.flush();
        glDepthMask(write_enabled);
        sWriteEnabled = write_enabled;
    }
}

LLGLDepthTest::~LLGLDepthTest()
{
    LL_PROFILE_ZONE_SCOPED_CATEGORY_PIPELINE;
    checkState();
    if (sDepthEnabled != mPrevDepthEnabled )
    {
        gGL.flush();
        if (mPrevDepthEnabled) glEnable(GL_DEPTH_TEST);
        else glDisable(GL_DEPTH_TEST);
        sDepthEnabled = mPrevDepthEnabled;
    }
    if (sDepthFunc != mPrevDepthFunc)
    {
        gGL.flush();
        glDepthFunc(mPrevDepthFunc);
        sDepthFunc = mPrevDepthFunc;
    }
    if (sWriteEnabled != mPrevWriteEnabled )
    {
        gGL.flush();
        glDepthMask(mPrevWriteEnabled);
        sWriteEnabled = mPrevWriteEnabled;
    }
}

void LLGLDepthTest::checkState()
{
    if (gDebugGL)
    {
        GLint func = 0;
        GLboolean mask = GL_FALSE;

        glGetIntegerv(GL_DEPTH_FUNC, &func);
        glGetBooleanv(GL_DEPTH_WRITEMASK, &mask);

        if (glIsEnabled(GL_DEPTH_TEST) != sDepthEnabled ||
            sWriteEnabled != mask ||
            sDepthFunc != func)
        {
            if (gDebugSession)
            {
                gFailLog << "Unexpected depth testing state." << std::endl;
            }
            else
            {
                LL_GL_ERRS << "Unexpected depth testing state." << LL_ENDL;
            }
        }
    }
}

LLGLSquashToFarClip::LLGLSquashToFarClip()
{
    glm::mat4 proj = get_current_projection();
    setProjectionMatrix(proj, 0);
}

LLGLSquashToFarClip::LLGLSquashToFarClip(const glm::mat4& P, U32 layer)
{
    setProjectionMatrix(P, layer);
}

void LLGLSquashToFarClip::setProjectionMatrix(glm::mat4 projection, U32 layer)
{
    F32 depth = 0.99999f - 0.0001f * layer;

    glm::vec4 P_row_3 = glm::row(projection, 3) * depth;
    projection = glm::row(projection, 2, P_row_3);

    LLRender::eMatrixMode last_matrix_mode = gGL.getMatrixMode();

    gGL.matrixMode(LLRender::MM_PROJECTION);
    gGL.pushMatrix();
    gGL.loadMatrix(glm::value_ptr(projection));

    gGL.matrixMode(last_matrix_mode);
}

LLGLSquashToFarClip::~LLGLSquashToFarClip()
{
    LLRender::eMatrixMode last_matrix_mode = gGL.getMatrixMode();

    gGL.matrixMode(LLRender::MM_PROJECTION);
    gGL.popMatrix();

    gGL.matrixMode(last_matrix_mode);
}



LLGLSyncFence::LLGLSyncFence()
{
    mSync = 0;
}

LLGLSyncFence::~LLGLSyncFence()
{
    if (mSync)
    {
        glDeleteSync(mSync);
    }
}

void LLGLSyncFence::placeFence()
{
    if (mSync)
    {
        glDeleteSync(mSync);
    }
    mSync = glFenceSync(GL_SYNC_GPU_COMMANDS_COMPLETE, 0);
}

bool LLGLSyncFence::isCompleted()
{
    bool ret = true;
    if (mSync)
    {
        GLenum status = glClientWaitSync(mSync, 0, 1);
        if (status == GL_TIMEOUT_EXPIRED)
        {
            ret = false;
        }
    }
    return ret;
}

void LLGLSyncFence::wait()
{
    if (mSync)
    {
        while (glClientWaitSync(mSync, 0, FENCE_WAIT_TIME_NANOSECONDS) == GL_TIMEOUT_EXPIRED)
        { //track the number of times we've waited here
        }
    }
}

LLGLSPipelineSkyBox::LLGLSPipelineSkyBox()
: mCullFace(GL_CULL_FACE)
, mSquashClip()
{
}

LLGLSPipelineSkyBox::~LLGLSPipelineSkyBox()
{
}

LLGLSPipelineDepthTestSkyBox::LLGLSPipelineDepthTestSkyBox(bool depth_test, bool depth_write)
: LLGLSPipelineSkyBox()
, mDepth(depth_test ? GL_TRUE : GL_FALSE, depth_write ? GL_TRUE : GL_FALSE, GL_LEQUAL)
{

}

LLGLSPipelineBlendSkyBox::LLGLSPipelineBlendSkyBox(bool depth_test, bool depth_write)
: LLGLSPipelineDepthTestSkyBox(depth_test, depth_write)
, mBlend(GL_BLEND)
{
    gGL.setSceneBlendType(LLRender::BT_ALPHA);
}

#if LL_WINDOWS
// Expose desired use of high-performance graphics processor to Optimus driver and to AMD driver
// https://docs.nvidia.com/gameworks/content/technologies/desktop/optimus.htm
extern "C"
{
    __declspec(dllexport) DWORD NvOptimusEnablement = 0x00000001;
    __declspec(dllexport) int AmdPowerXpressRequestHighPerformance = 1;
}
#endif


